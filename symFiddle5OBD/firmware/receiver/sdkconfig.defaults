## symFiddle5OBD/firmware/receiver/sdkconfig.defaults
```kconfig
# ---- 目标与 Flash ----
CONFIG_IDF_TARGET="esp32s3"
CONFIG_ESPTOOLPY_FLASHSIZE_32MB=y
CONFIG_ESPTOOLPY_FLASHMODE_QIO=y
CONFIG_ESPTOOLPY_FLASHFREQ_80M=y

# ---- PSRAM（板载 8 MB OCT）----
CONFIG_SPIRAM=y
CONFIG_SPIRAM_MODE_OCT=y
CONFIG_SPIRAM_SPEED_80M=y
CONFIG_SPIRAM_USE_MALLOC=y
CONFIG_SPIRAM_MALLOC_ALWAYSINTERNAL=8192

# ---- 分区 ----
CONFIG_PARTITION_TABLE_CUSTOM=y
CONFIG_PARTITION_TABLE_CUSTOM_FILENAME="partitions.csv"

# ---- LVGL ----
CONFIG_LV_COLOR_DEPTH_16=y
CONFIG_LV_MEM_CUSTOM=y
CONFIG_LV_USE_PERF_MONITOR=n
CONFIG_LV_FONT_MONTSERRAT_48=y
CONFIG_LV_FONT_MONTSERRAT_40=y
CONFIG_LV_FONT_MONTSERRAT_22=y

# ---- 性能 ----
CONFIG_COMPILER_OPTIMIZATION_PERF=y
CONFIG_FREERTOS_HZ=1000

# ---- 组件裁剪：只保留本工程真正用到的，显著缩短首次编译时间 ----
# 界面只有图片 + 文字，不需要文件系统、图像解码器、freetype
CONFIG_ESP_LVGL_ADAPTER_ENABLE_FS=n
CONFIG_ESP_LVGL_ADAPTER_ENABLE_DECODER=n
CONFIG_ESP_LVGL_ADAPTER_ENABLE_FREETYPE=n
CONFIG_ESP_LVGL_ADAPTER_ENABLE_FPS_STATS=n
CONFIG_ESP_LVGL_ADAPTER_ENABLE_BUTTON=n
CONFIG_ESP_LVGL_ADAPTER_ENABLE_KNOB=n

# LVGL 控件：只留 image / label / button / span
CONFIG_LV_USE_ANIMIMG=n
CONFIG_LV_USE_ARC=n
CONFIG_LV_USE_ARCLABEL=n
CONFIG_LV_USE_BAR=n
CONFIG_LV_USE_BARCODE=n
CONFIG_LV_USE_BUTTONMATRIX=n
CONFIG_LV_USE_CALENDAR=n
CONFIG_LV_USE_CANVAS=n
CONFIG_LV_USE_CHART=n
CONFIG_LV_USE_DROPDOWN=n
CONFIG_LV_USE_IMAGEBUTTON=n
CONFIG_LV_USE_KEYBOARD=n
CONFIG_LV_USE_LED=n
CONFIG_LV_USE_LINE=n
CONFIG_LV_USE_LIST=n
CONFIG_LV_USE_MENU=n
CONFIG_LV_USE_MSGBOX=n
CONFIG_LV_USE_QRCODE=n
CONFIG_LV_USE_ROLLER=n
CONFIG_LV_USE_SCALE=n
CONFIG_LV_USE_SLIDER=n
CONFIG_LV_USE_SPINBOX=n
CONFIG_LV_USE_SPINNER=n
CONFIG_LV_USE_SWITCH=n
CONFIG_LV_USE_TABLE=n
CONFIG_LV_USE_TABVIEW=n
CONFIG_LV_USE_TEXTAREA=n
CONFIG_LV_USE_TILEVIEW=n
CONFIG_LV_USE_WIN=n

# 不编译 LVGL 自带示例（它们引用了我们已关闭的控件）
CONFIG_LV_BUILD_EXAMPLES=n
CONFIG_LV_BUILD_DEMOS=n

# 刷新周期 33ms(30fps) -> 16ms，否则脏矩形把单帧压到 15ms 以下也上不去
CONFIG_LV_DEF_REFR_PERIOD=16

# 主频 160MHz -> 240MHz（S3 满速），逐像素绘制/变换直接快 50%
CONFIG_ESP_DEFAULT_CPU_FREQ_MHZ=240
CONFIG_ESP32S3_DEFAULT_CPU_FREQ_MHZ=240
```

## symFiddle5OBD/firmware/sender/sdkconfig.defaults
```kconfig
# ESP32-S3 N16R8
CONFIG_IDF_TARGET="esp32s3"

# 16MB Flash / 8MB Octal PSRAM
CONFIG_ESPTOOLPY_FLASHSIZE_16MB=y
CONFIG_SPIRAM=y
CONFIG_SPIRAM_MODE_OCT=y
CONFIG_SPIRAM_SPEED_80M=y

CONFIG_ESP_DEFAULT_CPU_FREQ_MHZ_240=y

# 只发 ESP-NOW，不开蓝牙（省 RAM 和功耗）
CONFIG_BT_ENABLED=n

# 关掉 Wi-Fi 省电，否则射频休眠会让 ESP-NOW 延迟抖动变大
CONFIG_ESP_WIFI_SLP_IRAM_OPT=y

# 日志级别：正式装车时改回 INFO；调协议时用 DEBUG
CONFIG_LOG_DEFAULT_LEVEL_INFO=y

# 自定义分区表：默认单 app 只给 1MB，不够用（理由见 partitions.csv 顶部注释）
CONFIG_PARTITION_TABLE_CUSTOM=y
CONFIG_PARTITION_TABLE_CUSTOM_FILENAME="partitions.csv"

# 日志只走 UART0：发送端只接 CH340，原生 USB 口悬空，
# 开着 USB-Serial-JTAG 次级控制台会导致应用启动后卡住（无主机时写阻塞）
CONFIG_ESP_CONSOLE_SECONDARY_NONE=y

# 与接收端对齐：调试优化(-Og)下启动会卡在 cpu_start，改 PERF
CONFIG_COMPILER_OPTIMIZATION_PERF=y
CONFIG_FREERTOS_HZ=1000

# 发送端不需要 8MB PSRAM（CAN 轮询几百 KB 就够）。
# 打开时 PERF 优化下会崩在 esp_psram_impl_enable，关掉排除这个变量。
# CONFIG_SPIRAM is not set
```
